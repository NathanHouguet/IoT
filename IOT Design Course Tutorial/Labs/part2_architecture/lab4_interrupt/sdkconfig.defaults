## IOT Design Course Tutorial/Labs/part2_architecture/lab4_interrupt/sdkconfig.defaults
```kconfig
# ESP32 with 4MB flash size
CONFIG_ESPTOOLPY_FLASHSIZE_4MB=y
CONFIG_ESPTOOLPY_FLASHSIZE="4MB"

# Disabled watchdog for interrupt and task
CONFIG_ESP_TASK_WDT_CHECK_IDLE_TASK_CPU0=n
CONFIG_ESP_INT_WDT=n
```

## IOT Design Course Tutorial/Labs/part7_wifi/lab1-1_wifi_connection/Kconfig.projbuild
```kconfig
menu "WIFI CONNECT"

config WIFI_SSID
    string "SSID"
    default "raspi-box-esp32"

config WIFI_PASSWORD
    string "PASSWORD"
    default "???"  

endmenu
```

## IOT Design Course Tutorial/Labs/part7_wifi/lab1-1_wifi_connection/sdkconfig.defaults
```kconfig
CONFIG_ESPTOOLPY_FLASHSIZE_4MB=y
CONFIG_ESPTOOLPY_FLASHSIZE="4MB"

# Connection to WiFi Box
CONFIG_WIFI_SSID="raspi-box-esp32"
CONFIG_WIFI_PASSWORD="???"
```

## Labs/part3_FreeRTOS/lab1-1_core_sched/sdkconfig.defaults
```kconfig
# ESP32 with 4MB flash size
CONFIG_ESPTOOLPY_FLASHSIZE_4MB=y
CONFIG_ESPTOOLPY_FLASHSIZE="4MB"

# disable watchdog for task
CONFIG_ESP_TASK_WDT=n

# ???
CONFIG_FREERTOS_UNICORE=y
```

## Labs/part3_FreeRTOS/lab2-1_single_msg_queue/sdkconfig.defaults
```kconfig
CONFIG_ESPTOOLPY_FLASHSIZE_4MB=y
CONFIG_ESPTOOLPY_FLASHSIZE="4MB"

# disable watchdog for task
CONFIG_ESP_TASK_WDT=n

# 2 cores to perform freertos
CONFIG_FREERTOS_UNICORE=n
```

## Labs/part4_inputs_outputs/lab1-2_adc/sdkconfig.defaults
```kconfig
CONFIG_ESPTOOLPY_FLASHSIZE_4MB=y
CONFIG_ESPTOOLPY_FLASHSIZE="4MB"

# disable watchdog for task
CONFIG_ESP_TASK_WDT=n
CONFIG_ESP_INT_WDT=n
```
